## conf/layer.conf
```bitbake
# We have a conf and classes directory, add to BBPATH
BBPATH .= ":${LAYERDIR}"

# We have recipes-* directories, add to BBFILES
BBFILES += "${LAYERDIR}/recipes-*/*/*.bb \
            ${LAYERDIR}/recipes-*/*/*.bbappend"

BBFILE_COLLECTIONS += "meta-imx8"
BBFILE_PATTERN_meta-imx8 = "^${LAYERDIR}/"
BBFILE_PRIORITY_meta-imx8 = "6"

LAYERDEPENDS_meta-imx8 = "core"
LAYERSERIES_COMPAT_meta-imx8 = "warrior zeus"
```

## conf/machine/hummingboard-pulse.conf
```bitbake
#@TYPE: Machine
#@NAME: SolidRun i.MX8MQ Hummingboard Pulse 
#@SOC: i.MX8MQ
#@DESCRIPTION: Machine configuration for SolidRun i.MX8MQ Hummingboard Pulse 
#@MAINTAINER: Maciej Pijanowski <maciej.pijanowski@3mdeb.com>

MACHINEOVERRIDES =. "mx8:mx8m:mx8mq:"

require conf/machine/include/imx-base.inc
require conf/machine/include/arm/arch-arm64.inc

MACHINE_FEATURES += "pci wifi bluetooth optee qca6174"

MACHINE_SOCARCH_FILTER_append_mx8mq = " virtual/libopenvg virtual/libgles1 virtual/libgles2 virtual/egl virtual/mesa virtual/libgl virtual/libg2d"

KERNEL_DEVICETREE = "freescale/fsl-imx8mq-hummingboard-pulse.dtb"

PREFERRED_PROVIDER_u-boot = "u-boot-solidrun-imx8"
PREFERRED_PROVIDER_virtual/bootloader = "u-boot-solidrun-imx8"
PREFERRED_PROVIDER_virtual/kernel = "linux-solidrun"

PREFERRED_VERSION_u-boot-solidrun = "v2018.11%"
PREFERRED_VERSION_linux-solidrun = "4.14%"

PLATFORM_FLAVOR_pn-optee-os = "mx8mqevk"

UBOOT_CONFIG ??= "sd"
UBOOT_CONFIG[sd] = "imx8mq_hb_defconfig"
SPL_BINARY = "spl/u-boot-spl.bin"

# Set DDR FIRMWARE
DDR_FIRMWARE_NAME = "lpddr4_pmu_train_1d_imem.bin lpddr4_pmu_train_1d_dmem.bin lpddr4_pmu_train_2d_imem.bin lpddr4_pmu_train_2d_dmem.bin"

# Set u-boot DTB
UBOOT_DTB_NAME = "fsl-imx8mq-hb.dtb"

# Set imx-mkimage boot target
IMXBOOT_TARGETS = "flash_evk flash_evk_no_hdmi flash_dp_evk"

# Set Serial console
SERIAL_CONSOLES = "115200;ttymxc0"

IMAGE_BOOTLOADER = "imx-boot"

LOADADDR = ""
UBOOT_SUFFIX = "bin"
UBOOT_MAKE_TARGET = ""
IMX_BOOT_SEEK = "33"

OPTEE_BIN_EXT = "8mq"

# Add additional firmware
MACHINE_FIRMWARE_append = " linux-firmware-ath10k"

IMAGE_BOOTFILES += "boot.scr"
do_image_wic[depends] += "u-boot-scr-solidrun-imx8:do_deploy"

# Use gstreamer 1.16 from meta-freescale
# PREFERRED_VERSION_gstreamer1.0 ?= "1.16.imx"
# PREFERRED_VERSION_gstreamer1.0-plugins-base ?= "1.16.imx"
# PREFERRED_VERSION_gstreamer1.0-plugins-good ?= "1.16.imx"
# PREFERRED_VERSION_gstreamer1.0-plugins-bad ?= "1.16.imx"
# PREFERRED_VERSION_gstreamer1.0-libav ?= "1.16.0"
```
